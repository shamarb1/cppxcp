ASAP2_VERSION 1 70
/begin PROJECT VOLVO_EXAMPLE ""
/begin MODULE XCP ""
/begin MOD_COMMON "" BYTE_ORDER MSB_LAST ALIGNMENT_BYTE 1 ALIGNMENT_WORD 1 ALIGNMENT_LONG 1 ALIGNMENT_FLOAT32_IEEE 1 ALIGNMENT_FLOAT64_IEEE 1 /end MOD_COMMON
/begin IF_DATA XCP
 /begin PROTOCOL_LAYER 0x0100 0x03E8 0xC8 0x00 0x00 0x00 0x00 0x00 0xFF /* Shall match XCP_MAX_CTO in xcp.h Same value is used for MAX_ODT_ENTRY_SIZE_DAQ in this file */ 300 /* Shall match XCP_MAX_DTO (XCP_MAX_DTO_LSB and XCP_MAX_DTO_MSB) in xcp.h */ BYTE_ORDER_MSB_LAST ADDRESS_GRANULARITY_BYTE OPTIONAL_CMD ALLOC_ODT_ENTRY OPTIONAL_CMD ALLOC_ODT OPTIONAL_CMD ALLOC_DAQ OPTIONAL_CMD FREE_DAQ OPTIONAL_CMD GET_DAQ_RESOLUTION_INFO OPTIONAL_CMD GET_DAQ_PROCESSOR_INFO OPTIONAL_CMD START_STOP_SYNCH OPTIONAL_CMD GET_DAQ_CLOCK OPTIONAL_CMD START_STOP_DAQ_LIST OPTIONAL_CMD GET_DAQ_LIST_MODE OPTIONAL_CMD SET_DAQ_LIST_MODE OPTIONAL_CMD WRITE_DAQ OPTIONAL_CMD SET_DAQ_PTR OPTIONAL_CMD CLEAR_DAQ_LIST OPTIONAL_CMD SHORT_UPLOAD OPTIONAL_CMD UPLOAD OPTIONAL_CMD SET_MTA OPTIONAL_CMD GET_ID OPTIONAL_CMD GET_COMM_MODE_INFO OPTIONAL_CMD BUILD_CHECKSUM OPTIONAL_CMD SET_SEGMENT_MODE OPTIONAL_CMD GET_SEGMENT_MODE OPTIONAL_CMD SET_REQUEST OPTIONAL_CMD GET_SEED OPTIONAL_CMD UNLOCK OPTIONAL_CMD COPY_CAL_PAGE SEED_AND_KEY_EXTERNAL_FUNCTION Seed_Key.dll /* Place file in C:\ETAS\INCA7.1\ETASShared11\Security (INCA 7.1) */ /end PROTOCOL_LAYER
 /begin DAQ DYNAMIC 0x00 0x06 0x00 OPTIMISATION_TYPE_DEFAULT ADDRESS_EXTENSION_FREE IDENTIFICATION_FIELD_TYPE_ABSOLUTE GRANULARITY_ODT_ENTRY_SIZE_DAQ_BYTE 0xFF /* Shall match XCP_MAX_CTO in xcp.h Same value is used for MAX_CTO in this file (absolute max: 0xFF) */ NO_OVERLOAD_INDICATION /begin TIMESTAMP_SUPPORTED 0x01 SIZE_DWORD UNIT_100US TIMESTAMP_FIXED /end TIMESTAMP_SUPPORTED /begin EVENT "10 ms" "10 ms" 0x01 DAQ_STIM 0xFF 0x0A 0x06 0x00 /end EVENT /begin EVENT "100 ms" "100 ms" 0x02 DAQ_STIM 0xFF 0x64 0x06 0x00 /end EVENT /begin EVENT "1000 ms" "1000 ms" 0x03 DAQ_STIM 0xFF 0x01 0x06 0x00 /end EVENT /end DAQ
 /begin PAG 0x01 FREEZE_SUPPORTED /end PAG
 /begin PGM PGM_MODE_ABSOLUTE 0x01 0x00 /begin SECTOR "Sector" 0x00 0x22014 0x38 0x00 0x00 0x00 /end SECTOR /end PGM
 /begin XCP_ON_UDP_IP 0x0100 /* HPA MODE */ DUMMY_PORT_VALUE /* Port number */ ADDRESS "169.254.4.10" /* SGA IP address */ /end XCP_ON_UDP_IP
/end IF_DATA
/begin MOD_PAR ""
 /begin MEMORY_SEGMENT caldata "caldata" DATA FLASH INTERN 0x1d2d8 0x9c48 -1 -1 -1 -1 -1
  /begin IF_DATA XCP
   /begin SEGMENT 0x00 0x02 0x00 0x00 0x00 /begin CHECKSUM XCP_CRC_16_CITT /end CHECKSUM
    /begin PAGE 0x00 ECU_ACCESS_WITH_XCP_ONLY XCP_READ_ACCESS_WITH_ECU_ONLY XCP_WRITE_ACCESS_NOT_ALLOWED INIT_SEGMENT 0x00 /end PAGE
    /begin PAGE 0x01 ECU_ACCESS_WITH_XCP_ONLY XCP_READ_ACCESS_WITH_ECU_ONLY XCP_WRITE_ACCESS_WITH_ECU_ONLY INIT_SEGMENT 0x00 /end PAGE
   /end SEGMENT
  /end IF_DATA
 /end MEMORY_SEGMENT
 /begin MEMORY_SEGMENT text ".text" CODE ROM INTERN 0x9C20 0x2631 -1 -1 -1 -1 -1
  /begin IF_DATA XCP
   /begin SEGMENT 0x01 0x01 0x00 0x00 0x00 /begin CHECKSUM XCP_CRC_16_CITT /end CHECKSUM
    /begin PAGE 0x01 ECU_ACCESS_WITH_XCP_ONLY XCP_READ_ACCESS_WITH_ECU_ONLY XCP_WRITE_ACCESS_WITH_ECU_ONLY INIT_SEGMENT 0x00 /end PAGE
   /end SEGMENT
  /end IF_DATA
 /end MEMORY_SEGMENT
/end MOD_PAR
/end MODULE
/end PROJECT
